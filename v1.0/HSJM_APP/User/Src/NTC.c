/*******************************************************************************
 * Project	:车载屏幕MCU开发_BOE成都
 * MCU	  	:GD32A503KCU3
 * Data		:2023/10/26
 * Files	:MPQ3367.c
 * Library	:V1.1.0, firmware for GD32A50x
 * Function	:NTC的功能应用函数
 * Author	:Liu Wei
 * Phone	:13349168457
 ******************************************************************************/
#include "NTC.h"


/*********************************************************************************************************
    定义“温度-采样值”数据转换表，范围从 -40～150 ℃
*********************************************************************************************************/
static const uint16_t ntc_adc[191] ={                                           //做实验，温度计
	4096, 3886, 3874, 3862, 3850, 3837, 3824, 3809, 3795, 3780, //-40~-31[0]
	3764, 3748, 3731, 3713, 3695, 3676, 3657, 3637, 3616, 3595, //-30~-21[10]
	3572, 3550, 3526, 3502, 3478, 3452, 3426, 3400, 3372, 3345, //-20~-11[20]
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	150, 147, 144, 141, 138, 136, 133, 130, 128, 125, 			//140~149
	123															//150
};



//================================================================================

/*
 * 函数名称：search_data()
 * 输    入:search_value   查找基准值
 * 输    出:none
 * 作    者:hyp
 * 日    期:2014.07.10
 * 功能描述：二分查找AD采样值
 *------------------------------------------------------------------------------
 *注意：
 * 1.返回值为查找表格中第一个小于查找值（search_value）的下标
 * 2.查找值(search_value)大于查找表中的最大值，返回1
 *   查找值(search_value)小于查找表格中最小值时，返回查找表格数量，即最大下标+1
*/
static int16_t search_data(uint16_t search_value)
{
    int16_t Right  ;
    int16_t Left = 0 ;
    int16_t mid ;

    Right  = NTC_ADC_ARRAY_NUM -1 ;			//右下标

    while(Left <= Right)
    {
        mid = (Right + Left)/2 ;

        if(search_value > ntc_adc[mid])		//因为温度升高，采样值反而下降，所以目标值（要找的值）大于中值，说明目标温度低于中间温度
        {
            Right = mid -1 ;
        }
        else
        {
            Left = mid + 1 ;
        }
    }
    
    return Left ;//返回的是下标
}

/*******************************************************************************
 * 函数名称：temper_calc()
 * 输    入:index   数组下标
 *          adc0_value  ad滤波后的采样值
 * 输    出:ntc温度的测量值  扩大了10倍
 * 作    者:hyp
 * 日    期:2014.07.10
 * 功能描述:温度计算(分段线性插值算法)
 ******************************************************************************/
static int16_t temper_calc(int16_t index,uint16_t adc0_value)
{
 //   int16_t temper  ;
    volatile int16_t Temp16 ;

    if(index <= 0)
    {
        return -400 ;	//-40摄氏度
    }
    else if(index >= (NTC_ADC_ARRAY_NUM-1))
    {
        return 1500 ;	//+150摄氏度
    }
    else
    {
        /***********************************************************************
        //=====直线近似计算========
        y1 = kx1 + b
        y2 = kx2 + b
        yn = kxn + b
            y2-y1           yn - y1
        k= ------------- = -------------
            x2 - x1         xn - x1
                (y2-y1)*(xn-x1)
        yn= ------------------------- + y1
                (x2 - x1)
        ***********************************************************************/
        Temp16 = ((int16_t)(ntc_adc[index]-adc0_value))*10;//查表对应的adc数-滤波的adc数
        Temp16 = Temp16 / ((int16_t)(ntc_adc[index-1]-ntc_adc[index])) ;//查表对应的adc数（温度）前面一个温度对应的adc数-查表对应的adc数
        Temp16 = (TEMPER_REF + index) * 10 + Temp16 ;
     
        return Temp16 ;
    } 
}
/*********************************************************************************************************
    NTC读取温度
*********************************************************************************************************/
uint8_t readTemper(uint16_t adc_filter,int16_t *Temp)
{
    int16_t index ;          //查表下标值
    int16_t temper ;
    
    index = search_data(adc_filter) ;
    temper = temper_calc(index,adc_filter) ;
    *Temp = temper ;
    if(temper >= 1500)
    { 
        return 1 ;	//读取的温度值错误  温度大于150度
    }
    else if(temper <= -400)
    {
        return 2 ;	//读取的温度值错误  温度小于-40度
    }
    else
    {
         return 0 ;
    }
   
   
   
}
         




/////////////////////////////////////////////////////////////////////////

uint32_t timeout_counter = 0;
uint16_t Adc_Value;
/*------------------------------------------------------------------------
*Function name		 :void McuInitialization(void) 
*Function description:获取adc采样的值
*Ipunt				 :none
*OutPut				 :直接采集到的值（ADC_RDATA(ADC0)）
*-------------------------------------------------------------------------*/
uint16_t get_adc_value(void) 
{
	adc_flag_clear(ADC0, ADC_FLAG_EOC);			
	while(SET != adc_flag_get(ADC0, ADC_FLAG_EOC)) 
	{
		timeout_counter++;
		if (timeout_counter >= ADC_TIMEOUT) 
			break;			
	}
	Adc_Value = ADC_RDATA(ADC0);	
	return Adc_Value;
}

/*------------------------------------------------------------------------
*Function name		 :void McuInitialization(void) 
*Function description:对adc采样的值进行均值滤波
*Ipunt				 :none
*OutPut				 :均值滤波后的模数转换值adc_mean_value
*-------------------------------------------------------------------------*/
float adc_mean_filter(void) 
{
    uint16_t adc_values[NUM_READS];
    uint32_t sum = 0;

    // 采集样本
    for (int i = 0; i < NUM_READS; ++i) 
	{
        adc_values[i] = get_adc_value();
    }

    // 计算总和
    for (int i = 0; i < NUM_READS; ++i) 
	{
        sum += adc_values[i];
    }

    // 计算平均值
    float adc_mean_value = (float)sum / NUM_READS;
    return adc_mean_value;
}









